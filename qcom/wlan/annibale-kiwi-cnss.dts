// SPDX-License-Identifier: BSD-3-Clause

/dts-v1/;
/plugin/;

#include "sun-kiwi-cnss-v8.dtsi"

/* POCO F8 Pro stock tree omits XOCAL nvmem/PBS properties on wlan_kiwi */
&wlan_kiwi {
	/delete-property/ nvmem-cells;
	/delete-property/ nvmem-cell-names;
	/delete-property/ wcal-pbs-supply;
};

/ {
	model = "Qualcomm Technologies, Inc. Sun MTP V8 Power Grid";
	compatible = "qcom,sun-mtp", "qcom,sun", "qcom,sunp-mtp", "qcom,sunp",
		     "qcom,mtp";
	qcom,msm-id = <618 0x10000>, <618 0x20000>, <639 0x10000>, <639 0x20000>,
		      <0x100026a 0x10000>, <0x100026a 0x20000>,
		      <0x100027f 0x10000>, <0x100027f 0x20000>;
	qcom,board-id = <0x40008 0>;
	xiaomi,miboard-id = <0xB 0>;
};
